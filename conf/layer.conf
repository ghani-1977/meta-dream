## conf/layer.conf
```bitbake
# We have a conf and classes directory, append to BBPATH
BBPATH .= ":${LAYERDIR}"

# We have a recipes directory, add to BBFILES
BBFILES += "${LAYERDIR}/recipes-*/*.bb ${LAYERDIR}/recipes-*/*.bbappend \
            ${LAYERDIR}/recipes-*/*/*.bb ${LAYERDIR}/recipes-*/*/*.bbappend \
            ${LAYERDIR}/recipes-*/*/*/*.bb ${LAYERDIR}/recipes-*/*/*/*.bbappend"

METADREAM_BASE := '${@os.path.normpath("${LAYERDIR}/../")}'
# Prevent current directory creeping into sstate objects. Otherwise, building
# in another TOPDIR will cause recipes using this variable to be rebuilt.
METADREAM_BASE[vardepvalue] = 'meta-dream'

LICENSE_PATH += "${LAYERDIR}/licenses"

#Include subversion, mercurial, msgfmt(gettext) and zip to hosttools
HOSTTOOLS += "svn msgfmt zip"

# The dynamic-layers directory hosts the extensions and layer specific
# modifications.
#
# The .bbappend and .bb files are included if the respective layer
# collection is available.
BBFILES += "${@' '.join('${LAYERDIR}/dynamic-layers/%s/recipes*/*/*.bbappend' % layer \
               for layer in BBFILE_COLLECTIONS.split())}"
BBFILES += "${@' '.join('${LAYERDIR}/dynamic-layers/%s/recipes*/*/*.bb' % layer \
               for layer in BBFILE_COLLECTIONS.split())}"
```

## conf/machine/dm500hdv2.conf
```bitbake
#@TYPE: Machine
#@NAME: Dreambox DM500HDv2
#@DESCRIPTION: Machine configuration for the Dreambox DM500HDv2

OPENPLI_FEATURES = "fan usbconsole"
MACHINE_FEATURES += "modem wlan kernelwifi externalwifi dvb-c blindscan-dvbc hdmicec"

require conf/machine/include/dreambox-hw-ecc.inc
require conf/machine/include/dreambox-nand-1024mb-2k.inc
require conf/machine/include/dreambox-part-1024mb.inc
require conf/machine/include/dreambox-ubi.inc
require conf/machine/include/dreambox-mips32el.inc

DVBMEDIASINK_CONFIG = "--with-pcm --with-wma --with-wmv --with-dtsdownmix --with-eac3"

CHIPSET = "bcm7405"
```

## conf/machine/dm520.conf
```bitbake
#@TYPE: Machine
#@NAME: Dreambox DM520
#@DESCRIPTION: Machine configuration for the Dreambox DM520

OPENPLI_FEATURES = "ci dvd usbconsole"
MACHINE_FEATURES += "modem wlan kernelwifi externalwifi dvb-c blindscan-dvbc hdmicec"
MACHINE_FEATURES += "libpassthrough recovery"

CHIPSET = "bcm73625"

require conf/machine/include/dreambox-mips32el.inc
require conf/machine/include/dreambox-mips32el-new.inc
```

## conf/machine/dm7020hd.conf
```bitbake
#@TYPE: Machine
#@NAME: Dreambox DM7020HD
#@DESCRIPTION: Machine configuration for the Dreambox DM7020HD

OPENPLI_FEATURES = "ci dvd usbconsole"
MACHINE_FEATURES += "modem wlan kernelwifi externalwifi dvb-c blindscan-dvbc hdmicec"
MACHINE_FEATURES += "libpassthrough"

require conf/machine/include/dreambox-hw-ecc.inc

DREAMBOX_ERASE_BLOCK_SIZE = "${@bb.utils.contains('EXACTNAME', 'dm7020hd', '0x40000', '0x20000', d)}"
DREAMBOX_FLASH_SIZE = "0x40000000"
DREAMBOX_SECTOR_SIZE = "${@bb.utils.contains('EXACTNAME', 'dm7020hd', '4096', '2048', d)}"
MKUBIFS_ARGS = "${@bb.utils.contains('EXACTNAME', 'dm7020hd', '-m 4096 -e 248KiB -c 1640 -x favor_lzo -F', '-m 2048 -e 124KiB -c 3320 -x favor_lzo -F', d)}"
UBINIZE_ARGS = "${@bb.utils.contains('EXACTNAME', 'dm7020hd', '-m 4096 -p 256KiB -s 4096', '-m 2048 -p 128KiB -s 2048', d)}"
UBINIZE_VOLSIZE = "${@bb.utils.contains('EXACTNAME', 'dm7020hd', '397MiB', '402MiB', d)}"
UBINIZE_DATAVOLSIZE = "${@bb.utils.contains('EXACTNAME', 'dm7020hd', '574MiB', '569MiB', d)}"

require conf/machine/include/dreambox-part-1024mb.inc
require conf/machine/include/dreambox-ubi.inc
require conf/machine/include/dreambox-mips32el.inc

PREFERRED_VERSION_linux-dreambox = "3.2"

DVBMEDIASINK_CONFIG = "--with-pcm --with-wma --with-wmv --with-dtsdownmix --with-eac3"

CHIPSET = "bcm7405"

MACHINE_EXTRA_RRECOMMENDS += "dreambox-enigma2-config"
```

## conf/machine/dm7020hdv2.conf
```bitbake
#@TYPE: Machine
#@NAME: Dreambox DM7020HDv2
#@DESCRIPTION: Machine configuration for the Dreambox DM7020HDv2

OPENPLI_FEATURES = "ci dvd usbconsole"
MACHINE_FEATURES += "modem wlan kernelwifi externalwifi dvb-c blindscan-dvbc hdmicec"
MACHINE_FEATURES += "libpassthrough"
MACHINE_ESSENTIAL_EXTRA_RDEPENDS += " dm-bootsplash"

require conf/machine/include/dreambox-hw-ecc.inc
require conf/machine/include/dreambox-nand-1024mb-2k.inc
require conf/machine/include/dreambox-part-1024mb.inc
require conf/machine/include/dreambox-ubi.inc
require conf/machine/include/dreambox-mips32el.inc

PREFERRED_VERSION_linux-dreambox = "3.2"

DVBMEDIASINK_CONFIG = "--with-pcm --with-wma --with-wmv --with-dtsdownmix --with-eac3"

CHIPSET = "bcm7405"

MACHINE_EXTRA_RRECOMMENDS += "dreambox-enigma2-config"

MACHINEOVERRIDES .= ":dm7020hd"
```

## conf/machine/dm800.conf
```bitbake
#@TYPE: Machine
#@NAME: Dreambox DM 800 HD PVR
#@DESCRIPTION: Machine configuration for the Dreambox DM 800 HD PVR

OPENPLI_FEATURES = "usbconsole"
MACHINE_FEATURES += "modem wlan dvb-c blindscan-dvbc"
MACHINE_FEATURES += "smallflash"

MACHINE_ESSENTIAL_EXTRA_RDEPENDS += " dm-bootsplash dm-shutdown dm-startupfix"

require conf/machine/include/dreambox-brcmnand.inc
require conf/machine/include/dreambox-nand-64mb.inc
require conf/machine/include/dreambox-part-64mb.inc
require conf/machine/include/dreambox-jffs2.inc
require conf/machine/include/dreambox-mips32el-nf.inc

DVBMEDIASINK_CONFIG = "--with-dreambox --with-dts=no"

CHIPSET = "bcm7401"
DVBPROVIDER = "v4l-dvb"

# Image fails to boot if kernel exceeds some unknown limit, so make that
# explicit here. I don't know what the actual limit is, but 6416679 boots
# and 6604470 didn't.
KERNEL_IMAGE_MAXSIZE = "6500000"

# Do not install samba due to small flash size
IMAGE_INSTALL_remove = "samba-base"
```

## conf/machine/dm8000.conf
```bitbake
#@TYPE: Machine
#@NAME: Dreambox DM8000
#@DESCRIPTION: Machine configuration for the Dreambox DM8000

OPENPLI_FEATURES = "ci dvd"
MACHINE_FEATURES += "pci wlan kernelwifi externalwifi dvb-c blindscan-dvbc frontprocessor"
MACHINE_FEATURES += "libpassthrough"

MACHINE_ESSENTIAL_EXTRA_RDEPENDS += " dm-bootsplash"

require conf/machine/include/dreambox-nand-256mb.inc
require conf/machine/include/dreambox-part-256mb.inc
require conf/machine/include/dreambox-ubi.inc
require conf/machine/include/dreambox-mips32el.inc

PREFERRED_VERSION_linux-dreambox = "3.2"

CHIPSET = "bcm7400"

MACHINE_EXTRA_RRECOMMENDS += "dreambox-enigma2-config"
```

## conf/machine/dm800se.conf
```bitbake
#@TYPE: Machine
#@NAME: Dreambox DM800se
#@DESCRIPTION: Machine configuration for the Dreambox DM800se

OPENPLI_FEATURES = "usbconsole"
MACHINE_FEATURES += "fan modem wlan kernelwifi dvb-c blindscan-dvbc hdmicec"
MACHINE_FEATURES += "libpassthrough smallflash"
MACHINE_ESSENTIAL_EXTRA_RDEPENDS += " dm-bootsplash"

require conf/machine/include/dreambox-brcmnand.inc
require conf/machine/include/dreambox-nand-64mb.inc
require conf/machine/include/dreambox-part-64mb.inc
require conf/machine/include/dreambox-jffs2.inc
require conf/machine/include/dreambox-mips32el.inc

PREFERRED_VERSION_linux-dreambox = "3.2"

DVBMEDIASINK_CONFIG = "--with-pcm --with-wma --with-wmv --with-dtsdownmix --with-eac3"

CHIPSET = "bcm7405"

# Image fails to boot if kernel exceeds some unknown limit, so make that
# explicit here. I don't know what the actual limit is, but 6416679 boots
# and 6604470 didn't.
KERNEL_IMAGE_MAXSIZE = "6500000"

# Do not install samba due to small flash size
IMAGE_INSTALL_remove = "samba-base"
```

## conf/machine/dm800sev2.conf
```bitbake
#@TYPE: Machine
#@NAME: Dreambox DM800sev2
#@DESCRIPTION: Machine configuration for the Dreambox DM800sev2

OPENPLI_FEATURES = "usbconsole"
MACHINE_FEATURES += "fan modem wlan kernelwifi externalwifi dvb-c blindscan-dvbc hdmicec"
MACHINE_FEATURES += "libpassthrough"
MACHINE_ESSENTIAL_EXTRA_RDEPENDS += " dm-bootsplash"

require conf/machine/include/dreambox-hw-ecc.inc
require conf/machine/include/dreambox-nand-1024mb-2k.inc
require conf/machine/include/dreambox-part-1024mb.inc
require conf/machine/include/dreambox-ubi.inc
require conf/machine/include/dreambox-mips32el.inc

PREFERRED_VERSION_linux-dreambox = "3.2"

DVBMEDIASINK_CONFIG = "--with-pcm --with-wma --with-wmv --with-dtsdownmix --with-eac3"

CHIPSET = "bcm7405"
```

## conf/machine/dm820.conf
```bitbake
#@TYPE: Machine
#@NAME: Dreambox DM820
#@DESCRIPTION: Machine configuration for the Dreambox DM820

OPENPLI_FEATURES = "ci dvd usbconsole"
MACHINE_FEATURES += "modem wlan kernelwifi externalwifi dvb-c blindscan-dvbc hdmicec"
MACHINE_FEATURES += "libpassthrough recovery v3d"

CHIPSET = "bcm7435"

require conf/machine/include/dreambox-mips32el.inc
require conf/machine/include/dreambox-mips32el-new.inc
```

## conf/machine/dm900.conf
```bitbake
#@TYPE: Machine
#@NAME: Dreambox DM900
#@DESCRIPTION: Machine configuration for the Dreambox DM900

OPENPLI_FEATURES = "ci dvd usbconsole"
MACHINE_FEATURES += "modem wlan kernelwifi dvb-c blindscan-dvbc hdmicec"
MACHINE_FEATURES += "libpassthrough recovery v3d"

CHIPSET = "bcm7252s"
SOC_FAMILY = "bcm7252s"

require conf/machine/include/dreambox-arm.inc
```

## conf/machine/include/dreambox-mips32el-new.inc
```bitbake
# dreambox-mips32el-new.inc

TARGET_ARCH = "mipsel"
DEFAULTTUNE = "mips32el"

MTD_KERNEL = "mtd2"

require conf/machine/include/dreambox-new.inc
require conf/machine/include/tune-mips32.inc

MACHINE_KERNEL_PR = "r14"
```

## conf/machine/include/dreambox-mips32el.inc
```bitbake
# dreambox-mips32el.inc

TARGET_ARCH = "mipsel"
DEFAULTTUNE = "mips32el"

MTD_KERNEL = "mtd2"

require conf/machine/include/dreambox.inc
require conf/machine/include/tune-mips32.inc

MACHINE_KERNEL_PR = "r14"

DVBMEDIASINK_CONFIG = "--with-machine=${MACHINE} --with-pcm --with-wma --with-wmv --with-dtsdownmix --with-eac3 --with-dts"
DVBMEDIASINK_CONFIG_dm8000 = "--with-machine=${MACHINE} --with-pcm --with-wma --with-wmv --with-dtsdownmix --with-eac3 --with-dts --with-limited-mpeg4v2"
DVBMEDIASINK_CONFIG_dm7080 = "--with-machine=${MACHINE} --with-pcm --with-wma --with-wmv --with-dtsdownmix --with-eac3 --with-dts --with-vb6 --with-vb8 --with-spark"
DVBMEDIASINK_CONFIG_dm820 = "--with-machine=${MACHINE} --with-pcm --with-wma --with-wmv --with-dtsdownmix --with-eac3 --with-dts --with-vb6 --with-vb8 --with-spark"
DVBMEDIASINK_CONFIG_dm520 = "--with-machine=${MACHINE} --with-pcm --with-wma --with-wmv --with-dtsdownmix --with-eac3 --with-dts --with-vb6 --with-vb8 --with-spark --with-h265"
```

## conf/machine/include/dreambox-ubi.inc
```bitbake
inherit image_types_nfi-new

IMAGE_FSTYPES ?= "ubinfi"
UBI_VOLNAME = "rootfs"
UBINIZE_VOLSIZE ?= "0"
UBINIZE_DATAVOL ?= "0"
```
